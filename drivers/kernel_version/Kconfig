## drivers/kernel_version/Kconfig
```kconfig
# SPDX-License-Identifier: GPL-2.0
config CHIRUNO_KERNEL_VERSION
	tristate "Read-only target kernel release metadata"
	depends on PROC_FS
	default n
	help
	  Expose this build's UTS_RELEASE through /proc/chiruno_kernel_version.
	  This is identity metadata, not a ROM compatibility or performance flag.
	  If built as a module, its name is chiruno_kernel_version.
```

## drivers/mihw/Kconfig
```kconfig
config MILLET_CGROUP
	tristate "frozen framework cgroup"
	depends on MIHW
	default n
	help
	  Mi frozen function

config MILLET_SIG
	tristate "frozen framework signal"
	depends on MIHW
	default n
	help
	  Mi frozen function

config MILLET_BINDER
	tristate "frozen framework binder"
	depends on MIHW
	default n
	help
	  Mi frozen function

config MILLET_PKG
	tristate "frozen framework pkg"
	depends on MIHW
	default n
	help
	  Mi frozen function

config MILLET_BINDER_GKI
	tristate "frozen framework binder gki"
	depends on MIHW
	default n
	help
	  Mi frozen function

config MILLET_CORE
	tristate "frozen framework core"
	depends on MIHW
	default n
	help
	  Mi frozen function

config MILLET_HS
	tristate "frozen framework hs"
	depends on MIHW
	default n
	help
	  Mi frozen function

config MI_UNION_POWER
	tristate "union power frame load monitor"
	depends on MIHW
	default n
	help
	  Bounded frame queue/vsync monitor. The ioctl path is disabled until
	  FRAME_MONITOR_ENABLE is explicitly set to 1.
```

## drivers/staging/binder_prio/Kconfig
```kconfig
config BINDER_PRIO
	tristate "Xiaomi binder prio"
	default n
	help
	  Apply a transaction-scoped RT floor to selected synchronous graphics
	  and camera transactions from RT senders. Receiver RT limits still
	  apply, stronger priorities are retained, and the Binder core restores
	  the previous priority. This does not reorder one-way transactions.
```
